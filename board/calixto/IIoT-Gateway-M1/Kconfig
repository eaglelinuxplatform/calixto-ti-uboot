## board/calixto/IIoT-Gateway-M1/Kconfig
```kconfig
if TARGET_IIOT_GATEWAY_M1

config SYS_BOARD
	default "IIoT-Gateway-M1"

config SYS_VENDOR
	default "calixto"

config SYS_SOC
	default "am33xx"

config SYS_CONFIG_NAME
	default "IIoT-Gateway-M1"
	
config 1024DDR3
	bool "Using 512MB RAM"
	default n
	
config 512DDR3
	bool "Using 512MB RAM"
	default n
	
config 256DDR3
	bool "Using 256MB RAM"
	default n

config NOR
	bool "Support for NOR flash"
	help
	  The AM335x SoC supports having a NOR flash connected to the GPMC.
	  In practice this is seen as a NOR flash module connected to the
	  "memory cape" for the BeagleBone family.


endif
```

## board/calixto/IoT-Gateway-Rosella/Kconfig
```kconfig
if TARGET_IOT_GATEWAY_ROSELLA

config SYS_BOARD
	default "IoT-Gateway-Rosella"

config SYS_VENDOR
	default "calixto"

config SYS_SOC
	default "am33xx"

config SYS_CONFIG_NAME
	default "IoT-Gateway-Rosella"
	
config 1024DDR3
	bool "Using 512MB RAM"
	default n
	
config 512DDR3
	bool "Using 512MB RAM"
	default n
	
config 256DDR3
	bool "Using 256MB RAM"
	default n

config NOR
	bool "Support for NOR flash"
	help
	  The AM335x SoC supports having a NOR flash connected to the GPMC.
	  In practice this is seen as a NOR flash module connected to the
	  "memory cape" for the BeagleBone family.


endif
```

## board/calixto/am335x_stamp_nxt/Kconfig
```kconfig
if TARGET_AM335X_STAMP_NXT

config SYS_BOARD
	default "am335x_stamp_nxt"

config SYS_VENDOR
	default "calixto"

config SYS_SOC
	default "am33xx"

config SYS_CONFIG_NAME
	default "am335x_stamp_nxt"
	
config 1024DDR3
	bool "Using 512MB RAM"
	default n
	
config 512DDR3
	bool "Using 512MB RAM"
	default n
	
config 256DDR3
	bool "Using 256MB RAM"
	default n

config NOR
	bool "Support for NOR flash"
	help
	  The AM335x SoC supports having a NOR flash connected to the GPMC.
	  In practice this is seen as a NOR flash module connected to the
	  "memory cape" for the BeagleBone family.


endif
```

## configs/am62lx_badge_defconfig
```kconfig
#include <configs/am62lx_evm_defconfig>

CONFIG_DEFAULT_DEVICE_TREE="ti/k3-am62l3-badge"
```
