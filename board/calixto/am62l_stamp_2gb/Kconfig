## board/calixto/am62l_stamp_2gb/Kconfig
```kconfig
# SPDX-License-Identifier: GPL-2.0+
#
# Copyright (C) 2025 Texas Instruments Incorporated - https://www.ti.com/
#

if TARGET_AM62L3_STAMP_2GB

config SYS_BOARD
       default "am62l_stamp_2gb"

config SYS_VENDOR
       default "calixto"

config SYS_CONFIG_NAME
       default "am62l_stamp_2gb"

source "board/calixto/common/Kconfig"

endif
```

## board/calixto/am62l_stamp_512mb/Kconfig
```kconfig
# SPDX-License-Identifier: GPL-2.0+
#
# Copyright (C) 2025 Texas Instruments Incorporated - https://www.ti.com/
#

if TARGET_AM62L3_STAMP_512MB

config SYS_BOARD
       default "am62l_stamp_512mb"

config SYS_VENDOR
       default "calixto"

config SYS_CONFIG_NAME
       default "am62l_stamp_512mb"

source "board/calixto/common/Kconfig"

endif
```

## board/calixto/stamp_lpddr/Kconfig
```kconfig
# SPDX-License-Identifier: GPL-2.0+
#
# Copyright (C) 2025 Texas Instruments Incorporated - https://www.ti.com/
#

if TARGET_AM62L3_STAMP_LPDDR

config SYS_BOARD
       default "stamp_lpddr"

config SYS_VENDOR
       default "calixto"

config SYS_CONFIG_NAME
       default "stamp_lpddr"

source "board/calixto/common/Kconfig"

endif
```
