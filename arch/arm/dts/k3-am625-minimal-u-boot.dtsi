// SPDX-License-Identifier: GPL-2.0
/*
 * Common AM625 MINIMAL dts file for SPLs
 * Copyright (C) 2021-2024 Texas Instruments Incorporated - https://www.ti.com/
 */

#include "k3-am625-sk-binman.dtsi"

/ {
	chosen {
		tick-timer = &main_timer0;
	};
};

&main_timer0 {
	clock-frequency = <25000000>;
};
